#include "../backend_select.h"
#if defined(ARDUINO_ARCH_ESP32) && PAL_ESP32_BACKEND_WEB
#include "../../audio.h"
#include "../../driver.h"
#include "../../global.h"
#include "DrvIf_internal.h"
#include <driver/i2s.h>
#include <freertos/FreeRTOS.h>
#include <freertos/semphr.h>
#include <freertos/task.h>
#include <stdio.h>
#include <stdlib.h>
#include <string.h>

#define CONFIG_SOUND_ENA
#define CONFIG_HW_EXTERNAL_DAC

// I2S port number
#define I2S_NUM           I2S_NUM_1
// I2S sample rate
#define I2S_SAMPLE_RATE   PAL_AUDIO_SAMPLING_RATE
// I2S DMA buffer count: 8 buffers gives ~160ms of headroom, preventing
// underruns when Core 1 is briefly preempted by WiFi interrupt handlers.
#define I2S_DMA_BUF_COUNT (8)
// I2S buffer length in bytes (one chunk worth of interleaved stereo PCM)
#define I2S_DMA_BUF_LEN   PAL_AUDIO_SAMPLES_PER_CHUNK * PAL_AUDIO_CHANNEL_COUNT * PAL_AUDIO_BYTES_PER_SAMPLE
// Please confirm PCM5102 pin configuration
#define I2S_BCK_IO        (14) // PCM5102 BCK PIN
#define I2S_DATA_IO       (12) // PCM5102 DIN PIN
#define I2S_WS_IO         (13) // PCM5102 LCK PIN

// Audio task configuration
#define AUDIO_TASK_STACK_SIZE (16384) // Nuked OPL3 call depth + resampler locals
#define AUDIO_TASK_PRIORITY   (configMAX_PRIORITIES - 2)
#define AUDIO_TASK_CORE       (1)     // Dedicated Core 1; Arduino loop runs on Core 0

static bool audio_running = false;
static TaskHandle_t audio_task_handle = NULL;
static void *buffer = NULL;
// Mutex protects shared audio state (RIX player, sound queue) between
// Core 0 game loop (AUDIO_PlayMusic / AUDIO_PlaySound) and Core 1 audio task.
static SemaphoreHandle_t audio_mutex = NULL;

void audio_callback(void)
{
    size_t bytes_written = 0;
    memset(buffer, 0, I2S_DMA_BUF_LEN);

    // Hold mutex only during synthesis; release before i2s_write so Core 0
    // can update music/sound state while the DMA is transmitting.
    DRIVER_Audio_Lock();
    AUDIO_FillBuffer(buffer, I2S_DMA_BUF_LEN);
    DRIVER_Audio_Unlock();

    // portMAX_DELAY: block until DMA has a free buffer slot.
    // Never drops samples regardless of game loop load.
    i2s_write(I2S_NUM, (const char *)buffer, I2S_DMA_BUF_LEN, &bytes_written, portMAX_DELAY);
}

// Audio playback task: continuously calls AUDIO_FillBuffer() to fill audio data and writes to I2S output
void audio_task(void *arg)
{
    (void)arg;
    printf("Audio task started...\n");
    audio_running = true;
    while (audio_running)
    {
        audio_callback();
    }
    printf("Audio task exiting...\n");
    vTaskDelete(NULL);
}

// Initialize ESP32 I2S and start playback task
int DRIVER_Init_Audio(void)
{
    printf("Audio parameters:\n");
    printf("Sample rate: %d Hz\n", I2S_SAMPLE_RATE);
    printf("DMA buffer count: %d\n", I2S_DMA_BUF_COUNT);
    printf("DMA buffer length: %d bytes\n", I2S_DMA_BUF_LEN);

#if defined(CONFIG_SOUND_ENA)
    // Create mutex before starting audio task
    audio_mutex = xSemaphoreCreateMutex();
    if (audio_mutex == NULL)
    {
        printf("Failed to create audio mutex\n");
        return ESP_FAIL;
    }

    i2s_config_t i2s_config = {
#if defined(CONFIG_HW_EXTERNAL_DAC)
        .mode = I2S_MODE_MASTER | I2S_MODE_TX,
#elif defined(CONFIG_HW_INTERNAL_DAC)
        .mode = I2S_MODE_MASTER | I2S_MODE_TX | I2S_MODE_DAC_BUILT_IN,
#endif
        .communication_format = I2S_COMM_FORMAT_I2S_MSB,
        .sample_rate = I2S_SAMPLE_RATE,
        .bits_per_sample = PAL_AUDIO_BIT_DEPTH,
        // RIGHT_LEFT: interleaved stereo (L/R pairs) as generated by the audio mixer.
        // Previous ONLY_RIGHT discarded all left-channel samples causing distortion.
        .channel_format = I2S_CHANNEL_FMT_RIGHT_LEFT,
        .intr_alloc_flags = 0,
        .dma_buf_count = I2S_DMA_BUF_COUNT,
        .dma_buf_len = I2S_DMA_BUF_LEN,
        .use_apll = false,
        .tx_desc_auto_clear = true,
    };

    esp_err_t err;
    err = i2s_driver_install(I2S_NUM, &i2s_config, 0, NULL);
    if (err != ESP_OK)
    {
        printf("Failed to install I2S driver: %d\n", (int)err);
        vSemaphoreDelete(audio_mutex);
        audio_mutex = NULL;
        return err;
    }

#if defined(CONFIG_HW_INTERNAL_DAC)
    i2s_set_pin(I2S_NUM, NULL);
    i2s_set_dac_mode(I2S_DAC_CHANNEL_LEFT_EN);
#elif defined(CONFIG_HW_EXTERNAL_DAC)
    // Configure I2S pins
    i2s_pin_config_t pin_config = {
        .bck_io_num = I2S_BCK_IO,
        .ws_io_num = I2S_WS_IO,
        .data_out_num = I2S_DATA_IO,
        .data_in_num = I2S_PIN_NO_CHANGE, // TX only, no receive needed
    };
    err = i2s_set_pin(I2S_NUM, &pin_config);
    if (err != ESP_OK)
    {
        printf("Failed to set I2S pins: %d\n", (int)err);
        i2s_driver_uninstall(I2S_NUM);
        vSemaphoreDelete(audio_mutex);
        audio_mutex = NULL;
        return err;
    }
#endif

    // DMA-capable buffer for audio mixing output
    buffer = heap_caps_calloc(PAL_AUDIO_SAMPLES_PER_CHUNK * PAL_AUDIO_CHANNEL_COUNT, PAL_AUDIO_BYTES_PER_SAMPLE, MALLOC_CAP_DMA | MALLOC_CAP_8BIT);
    if (buffer == NULL)
    {
        printf("Failed to allocate audio buffer\n");
        i2s_driver_uninstall(I2S_NUM);
        vSemaphoreDelete(audio_mutex);
        audio_mutex = NULL;
        return ESP_FAIL;
    }

    // Dedicated audio task on Core 1 with high priority.
    // Stack 16384: accommodates OPL3 call depth + resampler locals.
    // Core 1: avoids contention with WiFi/BT and Arduino loop on Core 0.
    if (xTaskCreatePinnedToCore(audio_task, "audio_task", AUDIO_TASK_STACK_SIZE, NULL,
                                AUDIO_TASK_PRIORITY, &audio_task_handle, AUDIO_TASK_CORE) != pdPASS)
    {
        printf("Failed to create audio task\n");
        heap_caps_free(buffer);
        buffer = NULL;
        i2s_driver_uninstall(I2S_NUM);
        vSemaphoreDelete(audio_mutex);
        audio_mutex = NULL;
        return ESP_FAIL;
    }
#endif
    printf("Audio initialized successfully.\n");
    return ESP_OK;
}

// Terminate audio playback and uninstall I2S driver
void DRIVER_DeInit_Audio(void)
{
    audio_running = false;

    if (audio_task_handle != NULL)
    {
        // Give the task time to observe audio_running = false and exit cleanly.
        vTaskDelay(pdMS_TO_TICKS(100));
        audio_task_handle = NULL;
    }

    if (buffer != NULL)
    {
        heap_caps_free(buffer);
        buffer = NULL;
    }

    if (audio_mutex != NULL)
    {
        vSemaphoreDelete(audio_mutex);
        audio_mutex = NULL;
    }

#if defined(CONFIG_SOUND_ENA)
    i2s_driver_uninstall(I2S_NUM);
#endif
}

void DRIVER_Audio_Lock(void)
{
    if (audio_mutex != NULL)
    {
        xSemaphoreTake(audio_mutex, portMAX_DELAY);
    }
}

void DRIVER_Audio_Unlock(void)
{
    if (audio_mutex != NULL)
    {
        xSemaphoreGive(audio_mutex);
    }
}
#endif /* ARDUINO_ARCH_ESP32 && PAL_ESP32_BACKEND_WEB */
